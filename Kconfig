## Kconfig
```kconfig
mainmenu "RT-Thread Configuration"

BSP_DIR := .

RTT_DIR := rt-thread

PKGS_DIR := packages

config SOC_STM32H723ZG
    bool
    select SOC_SERIES_STM32H7
    select RT_USING_COMPONENTS_INIT
    select RT_USING_USER_MAIN
    default y

# The first applicable default wins for the RT-Thread serial choice.
choice RT_USING_SERIAL_VERSION
    default RT_USING_SERIAL_V2 if BSP_USING_FLIGHT_DRIVERS
endchoice

source "$(RTT_DIR)/Kconfig"
osource "$PKGS_DIR/Kconfig"
rsource "libraries/Kconfig"
rsource "middleware/Kconfig"
rsource "applications/Kconfig"

if !RT_USING_NANO
rsource "board/Kconfig"
endif
```

## applications/Kconfig
```kconfig
menu "Flight application tasks"

config FLIGHT_RUNTIME_ENABLE
    bool "Run the Flight firmware pipeline (bench output inhibited)"
    default y
    depends on BSP_USING_FLIGHT_DRIVERS
    select RT_USING_MESSAGEQUEUE
    select RT_USING_ULOG
    select INS_BACKEND_ENABLE
    select SENSOR_PROCESSING_ENABLE
    select INS_REPLAY_ENABLE
    select SENSOR_INTEGRITY_ENABLE
    select FMS_ENABLE
    select GUIDANCE_ENABLE
    select CONTROLLER_ENABLE
    help
      Starts the real acquisition/navigation/control, FMS/guidance, MPC and
      actuator guard owners. Existing unverified parameters are for bench
      diagnostics only; M7 advertises zero physical output capability.
      GNU Arm C++14 is required. MATLAB is not part of this firmware image.

config FLIGHT_SIM_LINK
    bool "HIL sim link (FMT-SIM through the UDP bridge)"
    default n
    depends on FLIGHT_RUNTIME_ENABLE
    help
      Builds applications/tasks/communication/task_sim.c: MAVLink HIL over one UART
      (HIL_SENSOR/HIL_GPS in, HIL_ACTUATOR_CONTROLS/HEARTBEAT out) for the
      FMT-SIM SIH loop, with middleware/communication/sim/fmt_sim_udp_bridge.py
      as the PC-side serial-to-UDP bridge. The HIL serial driver takes the
      shared radio UART, while the ELRS UART remains independent. Native
      GNSS/baro/mag acquisition stops in HIL. Physical output stays inhibited
      (output_policy_id 1): the uplink carries the M6 demand, never an M7
      committed frame, so no motor can spin.

config FLIGHT_BENCH_TUNING
    bool "Enable local session tuning in the bench console"
    default y
    depends on FLIGHT_RUNTIME_ENABLE && FINSH_USING_MSH
    help
      Allows local changes to control gains while disarmed and output
      inhibited. A reboot reloads the compiled settings.

config FLIGHT_SKIP_ABI_LOCK
    bool "Skip release ABI lock during HIL (ABI lock is enabled by default)"
    default n
    depends on FLIGHT_SIM_LINK
    help
      Use the current source contracts for HIL without checking or advertising
      the released ABI fingerprint. The HIL wire protocol and runtime contract
      checks are still in effect.

config FLIGHT_TARGET_UTEST
    bool "Register Flight board unit tests"
    default n
    depends on FLIGHT_RUNTIME_ENABLE && FINSH_USING_MSH && RT_USING_HEAP
    select RT_USING_UTEST
    help
      Registers protocol and IPC cases for manual use from FinSH.

config FLIGHT_LOGGER_ENABLE
    bool "Record Flight data on SD"
    default y
    depends on FLIGHT_RUNTIME_ENABLE && BSP_USING_SDMMC && RT_USING_HEAP
    depends on RT_USING_DFS_V1 && RT_USING_DFS_ELMFAT
    help
      Writes flight snapshots and events to an existing FAT32 SD card.
      Uses a low-priority task and a separate bounded event queue.

config FLIGHT_NOR_LOG_ENABLE
    bool "Retain critical events on W25Q64 in BENCH_INHIBIT"
    default y
    depends on FLIGHT_RUNTIME_ENABLE && BSP_USING_FLIGHT_DRIVERS && RT_USING_MTD_NOR

endmenu
```

## board/Kconfig
```kconfig
menu "Hardware Drivers Config"

menu "Onboard Peripheral Drivers"

    config BSP_USING_FLIGHT_DRIVERS
        bool "Flight sensors, actuator, timebase and storage devices"
        default y
        select BSP_USING_UART
        select BSP_USING_SPI
        select BSP_USING_SPI1
        select BSP_SPI1_RX_USING_DMA
        select BSP_SPI1_TX_USING_DMA
        select RT_USING_I2C
        select BSP_USING_HARD_I2C1
        select BSP_USING_HARD_I2C2
        select BSP_USING_HARD_I2C4
        select BSP_I2C1_RX_USING_INT
        select BSP_I2C1_TX_USING_INT
        select BSP_I2C2_RX_USING_DMA
        select BSP_I2C2_TX_USING_DMA
        select BSP_I2C2_RX_USING_INT
        select BSP_I2C2_TX_USING_INT
        select BSP_I2C4_RX_USING_INT
        select BSP_I2C4_TX_USING_INT
        select BSP_USING_UART2
        select BSP_UART2_RX_USING_DMA
        select BSP_UART2_TX_USING_DMA
        select BSP_USING_UART3
        select BSP_UART3_RX_USING_DMA
        select BSP_USING_UART4
        select BSP_UART4_RX_USING_DMA
        select RT_USING_MTD_NOR
        select BSP_USING_SDIO
        select BSP_USING_SDIO1
        select BSP_USING_WDT
        select BSP_USING_RNG

endmenu

menu "On-chip Peripheral Drivers"

    config BSP_USING_USBD
        bool "Enable USB CDC device on PA11/PA12"
        default y
        depends on BSP_USING_FLIGHT_DRIVERS && RT_USING_HEAP
        select RT_USING_USB_DEVICE
        select BSP_USBD_TYPE_HS
        select BSP_USBD_PHY_EMBEDDED

    config BSP_USING_SPI
        bool "Enable SPI bus framework"
        select RT_USING_SPI
    config BSP_USING_SPI1
        bool "Enable SPI1 (ADIS)"
        depends on BSP_USING_SPI
    config BSP_SPI1_RX_USING_DMA
        bool "SPI1 receive DMA"
        depends on BSP_USING_SPI1
    config BSP_SPI1_TX_USING_DMA
        bool "SPI1 transmit DMA"
        depends on BSP_USING_SPI1
    config BSP_USING_HARD_I2C1
        bool "Enable I2C1 (BMM350)"
        select RT_USING_I2C
    config BSP_USING_HARD_I2C2
        bool "Enable I2C2 (current monitor bus)"
        select RT_USING_I2C
    config BSP_USING_HARD_I2C4
        bool "Enable I2C4 (BMP585)"
        select RT_USING_I2C
    config BSP_I2C1_RX_USING_INT
        bool
        depends on BSP_USING_HARD_I2C1
    config BSP_I2C1_TX_USING_INT
        bool
        depends on BSP_USING_HARD_I2C1
    config BSP_I2C2_RX_USING_DMA
        bool
        depends on BSP_USING_HARD_I2C2
    config BSP_I2C2_TX_USING_DMA
        bool
        depends on BSP_USING_HARD_I2C2
    config BSP_I2C2_RX_USING_INT
        bool
        depends on BSP_USING_HARD_I2C2
    config BSP_I2C2_TX_USING_INT
        bool
        depends on BSP_USING_HARD_I2C2
    config BSP_I2C4_RX_USING_INT
        bool
        depends on BSP_USING_HARD_I2C4
    config BSP_I2C4_TX_USING_INT
        bool
        depends on BSP_USING_HARD_I2C4
    config BSP_USING_UART2
        bool "Enable USART2 data radio"
        depends on BSP_USING_UART
    config BSP_USING_UART3
        bool "Enable USART3 RC byte stream"
        depends on BSP_USING_UART
    config BSP_USING_UART4
        bool "Enable UART4 GNSS"
        depends on BSP_USING_UART
    config BSP_UART2_RX_USING_DMA
        bool
        depends on BSP_USING_UART2
        select RT_SERIAL_USING_DMA
    config BSP_UART2_TX_USING_DMA
        bool
        depends on BSP_USING_UART2
        select RT_SERIAL_USING_DMA
    config BSP_UART2_RX_BUFSIZE
        int
        depends on BSP_USING_UART2 && RT_USING_SERIAL_V2
        default 2048
    config BSP_UART2_TX_BUFSIZE
        int
        depends on BSP_USING_UART2 && RT_USING_SERIAL_V2
        default 2048
    config BSP_UART2_DMA_PING_BUFSIZE
        int
        depends on BSP_UART2_RX_USING_DMA && RT_USING_SERIAL_V2
        default BSP_UART2_RX_BUFSIZE
    config BSP_UART3_RX_USING_DMA
        bool
        depends on BSP_USING_UART3
        select RT_SERIAL_USING_DMA
    config BSP_UART3_RX_BUFSIZE
        int
        depends on BSP_USING_UART3 && RT_USING_SERIAL_V2
        default 512
    config BSP_UART3_TX_BUFSIZE
        int
        depends on BSP_USING_UART3 && RT_USING_SERIAL_V2
        default 0
    config BSP_UART3_DMA_PING_BUFSIZE
        int
        depends on BSP_UART3_RX_USING_DMA && RT_USING_SERIAL_V2
        default BSP_UART3_RX_BUFSIZE
    config BSP_UART4_RX_USING_DMA
        bool
        depends on BSP_USING_UART4
        select RT_SERIAL_USING_DMA
    config BSP_UART4_RX_BUFSIZE
        int
        depends on BSP_USING_UART4 && RT_USING_SERIAL_V2
        default 2048
    config BSP_UART4_TX_BUFSIZE
        int
        depends on BSP_USING_UART4 && RT_USING_SERIAL_V2
        default 0
    config BSP_UART4_DMA_PING_BUFSIZE
        int
        depends on BSP_UART4_RX_USING_DMA && RT_USING_SERIAL_V2
        default BSP_UART4_RX_BUFSIZE
    config BSP_USING_SDIO
        bool "Enable SDMMC storage"
        select RT_USING_SDIO
    config BSP_USING_SDMMC
        def_bool BSP_USING_SDIO && (SOC_SERIES_STM32H7RS || SOC_SERIES_STM32H7 || \
                                    SOC_SERIES_STM32F7 || SOC_SERIES_STM32L4 || SOC_SERIES_STM32L5)
    config BSP_USING_SDIO1
        bool
        depends on BSP_USING_SDIO
    config BSP_USING_WDT
        bool "Register independent watchdog (supervisor starts/feeds it)"
        select RT_USING_WDT

    config BSP_USING_GPIO
        bool "Enable GPIO"
        select RT_USING_PIN
        default y

    menuconfig BSP_USING_UART
        bool "Enable UART"
        default y
        select RT_USING_SERIAL
        if BSP_USING_UART
            config BSP_STM32_UART_V1_TX_TIMEOUT
                int "UART TX timeout"
                default 6000
                depends on RT_USING_SERIAL_V1
                
            menuconfig BSP_USING_UART1
                bool "Enable UART1"
                default y
                if BSP_USING_UART1
                    config BSP_UART1_RX_BUFSIZE
                        int "Set UART1 RX buffer size"
                        range 64 65535
                        depends on RT_USING_SERIAL_V2
                        default 512

                    config BSP_UART1_TX_BUFSIZE
                        int "Set UART1 TX buffer size"
                        range 0 65535
                        depends on RT_USING_SERIAL_V2
                        default 0
                endif

        endif

    source "$(BSP_DIR)/libraries/HAL_Drivers/drivers/Kconfig"

endmenu

menu "Board extended module Drivers"

endmenu

endmenu
```

## middleware/Kconfig
```kconfig
menu "Flight business and data processing"
rsource "sensor/Kconfig"
rsource "model/Kconfig"
rsource "guidance/Kconfig"
endmenu
```

## middleware/guidance/Kconfig
```kconfig
config GUIDANCE_ENABLE
    bool "Guidance (M5)"
    default n
    depends on FMS_ENABLE
    help
        Build the M5 Guidance core (NONE obstacle source only:
        takeoff/point-to-point/hold/return/land reference generation with the
        anchor+24 preview and READY/ACTIVE lifecycle). A*/local map and
        obstacle avoidance are not admitted on the H723 profile and missions requiring
        avoidance are rejected. Off by default; no firmware default changes.
```

## middleware/model/Kconfig
```kconfig
menu "Flight models"
rsource "ins/Kconfig"
rsource "fms/Kconfig"
rsource "control/Kconfig"
endmenu
```

## middleware/model/control/Kconfig
```kconfig
config CONTROLLER_ENABLE
    bool "M6 QUAD controller (MPC/SO3/rate PID/allocation)"
    default n
    help
      Builds the fixed 15-variable/190-row OSQP 1.0.0 embedded solver,
      QUAD LTI ControlModelPort and ControllerPort. GNU Arm toolchain only.
      The 50 Hz integrator calls control_outer_update separately from the 1 kHz
      controller_update. This option does not create threads or enable motors.
      Target WCET and board/vehicle calibration remain unverified.
```

## middleware/model/fms/Kconfig
```kconfig
config FMS_ENABLE
    bool "QUAD_X4 AERIAL_FMS (M4)"
    default n
    help
        Build the QUAD_X4 M4/FMS core and the AERIAL_FMS product binding.
        Uses the production Schema 6.0 / Product-Port 0x00010906 contract.
        Call the serialized FmsPolicyPort from the application dispatcher;
        this option alone does not install a runtime thread or arm outputs.
```

## middleware/model/ins/Kconfig
```kconfig
config INS_BACKEND_ENABLE
    bool "Navigation backend (GNU Arm C++14)"
    default n

config INS_BARO_AIDING
    bool "Barometer height aiding"
    depends on INS_BACKEND_ENABLE
    default n

config INS_MAG_AIDING
    bool "Magnetometer heading aiding (requires verified calibration)"
    depends on INS_BACKEND_ENABLE
    default n

config INS_REPLAY_ENABLE
    bool "M3 navigation Port / alignment / history / shadow replay"
    default n
    depends on INS_BACKEND_ENABLE
    help
        Builds middleware/model/ins: the public EstimatorPort, static alignment,
        GNSS/barometer/magnetometer aiding, fixed-lag IMU ring, observation
        journal, 2304-byte checkpoints and shadow replay with commit guards.
        Requires the platform TimeService and explicit source use policies.
        The reference replay is serialized; no RTOS budget server is created.

        Requires INS_BACKEND_ENABLE (it links the trimmed estimator core).
        Off by default: the replay budget has no target WCET evidence yet and
        enabling it without the Gate C data is not authorized.
```

## middleware/sensor/Kconfig
```kconfig
config SENSOR_PROCESSING_ENABLE
    bool "M2 sensor management and sample processing"
    default n
    help
        Builds sensor payload processing and the GNSS log parser.
        The Flight application selects this option and adds device acquisition.

config SENSOR_INTEGRITY_ENABLE
    bool "Sensor Integrity Manager (source isolation and probation)"
    default n
    help
        Builds the source health state machine, sensor use policy and recovery
        probation described in spec 05. It consumes evidence such as rejected
        samples, device faults and timeouts.
```
